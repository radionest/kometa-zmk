## boards/shields/kometa/Kconfig.defconfig
```kconfig
if SHIELD_KOMETA_DONGLE

config ZMK_KEYBOARD_NAME
    default "kometa"

config ZMK_SPLIT_ROLE_CENTRAL
    default y

config ZMK_SPLIT
    default y

config ZMK_SPLIT_BLE_CENTRAL_PERIPHERALS
    default 2

endif
```
